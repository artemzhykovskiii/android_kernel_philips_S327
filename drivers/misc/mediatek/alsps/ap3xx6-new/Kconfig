## drivers/misc/mediatek/alsps/ap3xx6-new/Kconfig
```kconfig
config MTK_AP3XX6_NEW
	bool "ap3xx6 for MediaTek package"
	default n
	help
	It support different type sensor
	in this platform. If this option
	is set, it will support ambient
	and light sensor AP3426 or AP3216C.
```
